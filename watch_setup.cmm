// T32TEST001 Wed Nov 25 10:14:02 2015

 B::
 
 BREAK.RESET
 B.S   _Terminate\3 /P
 V.B.S Per_CPU_Information[0].per_cpu.thread_dispatch_disable_level; /R /W /TD
 
 ENDDO
